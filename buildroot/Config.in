## buildroot/Config.in
```kconfig
source "$BR2_EXTERNAL_MOGGIE_PATH/package/sonosd/Config.in"
source "$BR2_EXTERNAL_MOGGIE_PATH/package/dlna/Config.in"
```

## buildroot/package/dlna/Config.in
```kconfig
config BR2_PACKAGE_DLNA
	bool "dlna"
	depends on BR2_TOOLCHAIN_HAS_THREADS
	help
	  Moggie's UPnP AV MediaRenderer: SSDP discovery, an HTTP/1.1 server,
	  AVTransport/RenderingControl/ConnectionManager over SOAP, and GENA
	  eventing. This is what gives Home Assistant a real media_player
	  through its dlna_dmr integration.

	  Built from the in-tree source at firmware/dlna.
```

## buildroot/package/sonosd/Config.in
```kconfig
config BR2_PACKAGE_SONOSD
	bool "sonosd"
	depends on BR2_TOOLCHAIN_HAS_THREADS
	help
	  Moggie's audio daemon: owns /dev/dsp and /dev/audioctl, arbitrates
	  between audio sources and speaks MQTT.

	  Built from the in-tree source at firmware/sonosd.
```
